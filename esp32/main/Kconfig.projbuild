## esp32/main/Kconfig.projbuild
```kconfig
menu "D200 host"

    config D200_WIFI_SSID
        string "WiFi SSID"
        default ""

    config D200_WIFI_PASSWORD
        string "WiFi password"
        default ""

    config D200_WIFI_TX_POWER
        int "WiFi TX power (units of 0.25 dBm, 8..84)"
        range 8 84
        default 80
        help
            WiFi transmit bursts can pull the 5 V of the USB-OTG port down and break the link to the
            D200. A low power is plenty at a good signal (RSSI -50 dBm or better).

    config D200_DEBUG
        bool "Debug output (ADB message trace, device kernel log, USB host log)"
        default y
        help
            Logs every ADB message with its time, dumps the D200's dmesg once the bootstrap ran and turns
            on the ESP-IDF USB host logs (needs "Maximum log verbosity: Debug", see sdkconfig.defaults).

    config D200_SELFTEST
        bool "Draw test images on key 0 at every connection (timing log)"
        default n

    config D200_TIMEZONE
        string "Time zone (POSIX TZ string)"
        default "CET-1CEST,M3.5.0,M10.5.0/3"
        help
            For the clock and {time}/{date}. The default is Central Europe with daylight saving time.

endmenu
```

## esp32/sdkconfig.defaults
```kconfig
CONFIG_LOG_MAXIMUM_LEVEL_DEBUG=y
CONFIG_LOG_DEFAULT_LEVEL_INFO=y
CONFIG_IDF_TARGET="esp32s3"
CONFIG_ESPTOOLPY_FLASHSIZE_16MB=y
CONFIG_PARTITION_TABLE_CUSTOM=y
CONFIG_PARTITION_TABLE_CUSTOM_FILENAME="partitions.csv"
CONFIG_ESPTOOLPY_FLASHMODE_QIO=y
CONFIG_HTTPD_WS_SUPPORT=n
CONFIG_HTTPD_MAX_REQ_HDR_LEN=1024
CONFIG_HTTPD_MAX_URI_LEN=256
CONFIG_LWIP_MAX_SOCKETS=16
CONFIG_ESP_DEFAULT_CPU_FREQ_MHZ_240=y
CONFIG_SPIRAM=y
CONFIG_SPIRAM_MODE_OCT=y
CONFIG_SPIRAM_USE_MALLOC=y
CONFIG_SPIRAM_MALLOC_ALWAYSINTERNAL=4096
CONFIG_ESP_MAIN_TASK_STACK_SIZE=8192
```
